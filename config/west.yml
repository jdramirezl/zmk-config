## config/west.yml
```yaml
manifest:
  remotes:
    - name: zmkfirmware
      url-base: https://github.com/zmkfirmware
    - name: M165437 #new entry
      url-base: https://github.com/M165437 #new entry
    - name: jdramirezl
      url-base: https://github.com/jdramirezl
  projects:
    - name: zmk
      remote: zmkfirmware
      revision: main
      import: app/west.yml
    - name: nice-view-gem #new entry
      remote: M165437 #new entry
      revision: main #new entry
    - name: nice-view-gem-jdramirezl
      remote: jdramirezl
      revision: main

  self:
    path: config  
```
